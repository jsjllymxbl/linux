## Documentation/devicetree/bindings/power/supply/qcom,pm8921-bms.yaml
```yaml
# SPDX-License-Identifier: (GPL-2.0-only OR BSD-2-Clause)
%YAML 1.2
---
$id: http://devicetree.org/schemas/power/supply/qcom,pm8921-bms.yaml#
$schema: http://devicetree.org/meta-schemas/core.yaml#

title: Qualcomm PM8921 battery monitor

maintainers:
  - jsjllymxbl <jsjllymxbl@gmail.com>

description: |
  The PM8921 PMIC integrates a battery monitor system (BMS): a coulomb
  counter with its own ADC that measures the battery voltage and the
  voltage across the pack current sense resistor.  It is the only source
  of battery data on the boards that use this PMIC without an external
  fuel gauge.

properties:
  compatible:
    const: qcom,pm8921-bms

  reg:
    maxItems: 1

  qcom,r-sense-mohm:
    description: Value of the current sense resistor between the battery
      and the system, in milliohms.
    default: 10
    minimum: 1

  monitored-battery:
    description: |
      Phandle to the battery node that describes the pack: the driver
      needs its open circuit voltage to capacity table and its internal
      resistance to turn the measured terminal voltage into a state of
      charge.
    maxItems: 1

required:
  - compatible
  - reg
  - monitored-battery

additionalProperties: false

examples:
  - |
    battery: battery {
        compatible = "simple-battery";
        constant-charge-voltage-max-microvolt = <4200000>;
        charge-full-design-microamp-hours = <2000000>;
        factory-internal-resistance-micro-ohms = <236000>;
        ocv-capacity-celsius = <25>;
        ocv-capacity-table-0 = <4163000 100>, <4108000 95>, <4069000 90>,
                               <4019000 85>, <3981000 80>, <3954000 75>,
                               <3400000 1>, <3000000 0>;
    };

    pmic {
        #address-cells = <1>;
        #size-cells = <0>;

        battery-monitor@224 {
            compatible = "qcom,pm8921-bms";
            reg = <0x224>;

            monitored-battery = <&battery>;
            qcom,r-sense-mohm = <10>;
        };
    };
...
```

## Documentation/devicetree/bindings/power/supply/qcom,pm8921-charger.yaml
```yaml
# SPDX-License-Identifier: (GPL-2.0-only OR BSD-2-Clause)
%YAML 1.2
---
$id: http://devicetree.org/schemas/power/supply/qcom,pm8921-charger.yaml#
$schema: http://devicetree.org/meta-schemas/core.yaml#

title: Qualcomm PM8921 switch mode battery charger

maintainers:
  - jsjllymxbl <jsjllymxbl@gmail.com>

description: |
  The PM8921 PMIC integrates a single cell lithium ion switch mode battery
  charger (SMBC) with one USB and one DC input path.  The charge cycle is run
  by the charger state machine; software only programs the voltage and current
  limits and optionally restricts the USB input current.

  Whether a cable is plugged in is reported by the extcon device of the PMIC,
  which owns the VBUS valid interrupt of the block.

properties:
  compatible:
    const: qcom,pm8921-charger

  reg:
    maxItems: 1

  extcon:
    description: |
      Phandle to the extcon device that reports the USB cable.  The charger
      follows it to rearm a charge cycle that failed before the cable was
      plugged in and to update the state of its power supplies.
    maxItems: 1

  interrupts:
    maxItems: 11

  interrupt-names:
    items:
      - const: chg-gone
      - const: batt-temp-ok
      - const: batt-hot
      - const: batt-cold
      - const: fast-chg
      - const: chg-done
      - const: chg-fail
      - const: vbat-det
      - const: wdog
      - const: batt-inserted
      - const: chg-hot

  qcom,max-voltage-mv:
    description: Battery float voltage in millivolts.
    minimum: 3400
    maximum: 4500
    default: 4200

  qcom,resume-voltage-delta-mv:
    description: |
      Voltage drop below the float voltage that restarts charging once the
      battery has been fully charged, in millivolts.
    default: 20

  qcom,term-current-ma:
    description: End of charge current in milliamps.
    minimum: 50
    maximum: 200
    default: 100

  qcom,max-charge-current-ma:
    description: Maximum battery charge current in milliamps.
    minimum: 325
    maximum: 2000
    default: 1000

  qcom,usb-current-limit-ma:
    description: |
      Default USB input current limit in milliamps.  It can be changed at
      runtime through the "input_current_limit" property of the registered
      power supply.
    default: 500

  qcom,safety-time-min:
    description: Maximum total charge time in minutes.
    minimum: 4
    maximum: 512
    default: 480

required:
  - compatible
  - reg
  - extcon

additionalProperties: false

examples:
  - |
    #include <dt-bindings/interrupt-controller/irq.h>

    pmic {
        #address-cells = <1>;
        #size-cells = <0>;
        interrupt-controller;
        #interrupt-cells = <2>;

        charger@204 {
            compatible = "qcom,pm8921-charger";
            reg = <0x204>;

            extcon = <&pmic>;

            interrupts-extended = <&pmic 27 IRQ_TYPE_EDGE_RISING>,
                                  <&pmic 26 IRQ_TYPE_EDGE_BOTH>,
                                  <&pmic 30 IRQ_TYPE_EDGE_RISING>,
                                  <&pmic 28 IRQ_TYPE_EDGE_RISING>,
                                  <&pmic 17 IRQ_TYPE_EDGE_BOTH>,
                                  <&pmic 21 IRQ_TYPE_EDGE_RISING>,
                                  <&pmic 20 IRQ_TYPE_EDGE_RISING>,
                                  <&pmic 45 IRQ_TYPE_EDGE_RISING>,
                                  <&pmic 9 IRQ_TYPE_EDGE_RISING>,
                                  <&pmic 13 IRQ_TYPE_EDGE_BOTH>,
                                  <&pmic 29 IRQ_TYPE_EDGE_RISING>;
            interrupt-names = "chg-gone", "batt-temp-ok", "batt-hot",
                              "batt-cold", "fast-chg", "chg-done",
                              "chg-fail", "vbat-det", "wdog",
                              "batt-inserted", "chg-hot";

            qcom,max-voltage-mv = <4200>;
            qcom,max-charge-current-ma = <1000>;
            qcom,term-current-ma = <100>;
        };
    };
...
```
